//Arduino Standard Library LEDControl
#include "LedControl.h"

LedControl lc=LedControl(8,9,10,2);
int ndev = 0;
const int index[16]={4,11,10,9,3,2,3,4,5,12,6,5,8,1,1,2};
const int chip[16]={1,0,0,0,1,0,0,0,0,0,1,1,0,0,1,1};
const char segs[16]={'u','t','s','r','p','n','m','k','h','g','f','e','d','c','b','a'};
const uint16_t SixteenSegmentASCII[96] = {
  0b0000000000000000, /* (space) */
  0b0000000000001100, /* ! */
  0b0000001000000100, /* " */
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  0b0000000000000000, /* (del) */
};

void setupSixteen()
{
  ndev = lc.getDeviceCount();
  for (int i = 0; i < ndev; i++)
  {
    lc.shutdown(i,false);
    /* Set the brightness to a medium values */
    lc.setIntensity(i,15);
    /* and clear the display */
    lc.clearDisplay(i);    
  }
}

void testSixteen(bool toggle)
{
  for(int digit=0; digit<ndev*2; digit++)
  {
    int digitOffset = 0;
    for(int i = 0; i < 16; i++)
    {
      int chipNum = chip[15-i];
      if (chipNum == 0)
      {
        digitOffset = digit*14;
      }
      else
      {
        digitOffset = digit*7;
      }
      int position = (index[15-i]+digitOffset);
      lc.setLed(chipNum, position/7, position%7, toggle); 
    }
  }
}
void printSixteen(char c, int digit)
{
  int digitOffset = 0;
  for(int i = 0; i < 16; i++)
  {
    int bitVal = (SixteenSegmentASCII[c-32]>>i)&0x01;
//    Serial.print("Char: ");
//    Serial.print(c);
//    Serial.print("\tChar Num: ");
//    Serial.print(int(c-32));
//    Serial.print("\tIndex: ");
//    Serial.print(i);
//    Serial.print("\tState: ");
//    Serial.print(bitVal);
//    Serial.print("\tChip: ");
//    Serial.print(chip[15-i]);
//    Serial.print("\tPin: ");
//    Serial.print(index[15-i]);
//    Serial.print("\tSeg: ");
//    Serial.println(segs[15-i]);
//    lc.setLed(chip[15-i], index[15-i]/7, index[15-i]%7, true); 
//    delay(50);
//    lc.setLed(chip[15-i], index[15-i]/7, index[15-i]%7, false); 
//    delay(50);
//    
    int chipNum = chip[15-i];
    if (chipNum == 0)
    {
      digitOffset = digit*14;
    }
    else
    {
      digitOffset = digit*7;
    }
    int position = (index[15-i]+digitOffset);
    lc.setLed(chipNum, position/7, position%7, bitVal); 
//    delay(5000);
  }
}
